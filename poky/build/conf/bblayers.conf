## poky/build/conf/bblayers.conf
```bitbake
# POKY_BBLAYERS_CONF_VERSION is increased each time build/conf/bblayers.conf
# changes incompatibly
POKY_BBLAYERS_CONF_VERSION = "2"

BBPATH = "${TOPDIR}"
BBFILES ?= ""

BBLAYERS ?= " \
  /home/rios/poky/meta \
  /home/rios/poky/meta-poky \
  /home/rios/poky/meta-yocto-bsp \
  /home/rios/poky/meta-raspberrypi \
  /home/rios/poky/meta-openembedded/meta-oe \
  /home/rios/poky/meta-openembedded/meta-python \
  /home/rios/poky/meta-mci \
  "
```
